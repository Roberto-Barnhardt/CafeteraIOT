/*
Hecho:
  - Rotary encoder contando correctamente.
Por hacer:
  - MQTT...
  - OLED...
  - MENU ENTERO...
*/


//----------------------------------------------------------------------------------
// DISPLAY SETUP
//----------------------------------------------------------------------------------
// Libraries
#include <Wire.h>
#include <Adafruit_GFX.h>
#include <Adafruit_SSD1306.h>

// Definitions
#define SCREEN_WIDTH 128 // OLED display width, in pixels
#define SCREEN_HEIGHT 64 // OLED display height, in pixels
#define OLED_RESET     -1 // Reset pin # (or -1 if sharing Arduino reset pin)
#define SCREEN_ADDRESS 0x3C ///< See datasheet for Address; 0x3D for 128x64, 0x3C for 128x32
Adafruit_SSD1306 display(SCREEN_WIDTH, SCREEN_HEIGHT, &Wire, OLED_RESET);

// Functions

//----------------------------------------------------------------------------------
// DISPLAY GEOMETRY
//----------------------------------------------------------------------------------
//BACKGROUND
const unsigned char PROGMEM background[]={
  0x00,0x00,0x00,0x00,0x00,0x00,0x00,0x00,0x00,0x00,0x00,0x00,0x00,0x00,0x00,0x00,
  0x00,0x00,0x00,0x00,0x7F,0x80,0x00,0x00,0x00,0x00,0x00,0x00,0x00,0x00,0x00,0x00,
  0x00,0x00,0x00,0x00,0x7F,0xBF,0xBF,0xBF,0xBF,0xB0,0x5F,0xCF,0xC0,0x00,0x00,0x00,
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  0x00,0x00,0x00,0x00,0x00,0x1F,0xFF,0xFF,0xFF,0xFF,0xF0,0x00,0x00,0x00,0x00,0x00,
};

//MENU ICONS
const int16_t col_a = 3;
const int16_t col_b = 48;
const int16_t col_c = 95;
const int16_t icon_height = 32;
const int16_t icon_width = 32;
const int16_t icon_toprow = 19;
const int16_t text_row = 54;
const unsigned char PROGMEM coffee_icon[] = {
  0x00,0x00,0x00,0x00,
  0x00,0x03,0x00,0x00,
  0x00,0x03,0x00,0x00,
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  0x00,0x7F,0xF0,0x00
};
const unsigned char PROGMEM clock_icon[] = {
  0x00,0x00,0x00,0x00,
  0x00,0x0F,0xF0,0x00,
  0x00,0x3F,0xFC,0x00,
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  0x00,0x00,0x00,0x00
};

const unsigned char PROGMEM exit_icon[] = {
  0x1F,0xFF,0xFF,0xFF,
  0x1F,0xFF,0xFF,0xFF,
  0x18,0x00,0x00,0x07,
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  0x1F,0xFF,0xFF,0xFF
};
//ARRAYS
const unsigned int num_items = 3;
const unsigned char* menu_icons[num_items]{
  coffee_icon,
  clock_icon,
  exit_icon,
};
char menu_items[num_items][20]={
  {"CAFE"},
  {"ALARM"},
  {"EXIT"},
};
//----------------------------------------------------------------------------------
// ENCODER SETUP
//----------------------------------------------------------------------------------
// Libraries
#include <ESP32Encoder.h> 

// Definitions
#define encA 17 
#define encB 16 
#define encSW 5
long currentPos = 0;
long lastPos = 0;
bool stuffChanged = false;
ESP32Encoder encoder;

// Functions

void doEncoder() {

  currentPos = encoder.getCount() / 2;

  // Handle wrapping around from the start to the end
  if (currentPos < 0) {
    encoder.setCount((num_items - 1) * 2);
    currentPos = encoder.getCount() / 2;
    lastPos = currentPos;
    stuffChanged = true;
  }
  // Handle wrapping around from the end to the start
  else if (currentPos > num_items - 1) {
    encoder.setCount(0);
    currentPos = encoder.getCount() / 2;
    lastPos = currentPos;
    stuffChanged = true;
  } 
  // Normal increment/decrement
  else if (currentPos != lastPos) {
    lastPos = currentPos;
    stuffChanged = true;
  }
}
//----------------------------------------------------------------------------------
// STATES
//----------------------------------------------------------------------------------
//Definitions
unsigned int state = 1;
//unsigned int next_state = 0;
/*
state 0 = Dashboard
state 1 = Menu
state 2 = Make coffe page
state 3 = Set alarm page
*/
//Functions
void doStates(){
  static unsigned long last_interrupt_time = 0;
  unsigned long interrupt_time = millis();
  if (interrupt_time - last_interrupt_time > 200) {
    if(state == 1){
      switch(currentPos) {
        case 0:
        state = 2; //Make coffee
        break;
        case 1:
        state = 3; //Set alarm
        break;
        case 2:
        state = 0; //Exit from menu
        break;
      }
    }else{
      state = 1;
    }
    last_interrupt_time = interrupt_time;
  }  
}

//----------------------------------------------------------------------------------
// SETUP
//----------------------------------------------------------------------------------
void setup() {
  // Serial----------------------------------------------
  Serial.begin(115200);
  
  // Encoder---------------------------------------------
  encoder.attachHalfQuad(encB, encA);
  encoder.setCount(0);  
  pinMode(encSW, INPUT_PULLUP);
  attachInterrupt(encSW, doStates, FALLING);

  // Display---------------------------------------------------------
  if(!display.begin(SSD1306_SWITCHCAPVCC, SCREEN_ADDRESS)) {
    Serial.println(F("SSD1306 allocation failed"));
    for(;;); // Don't proceed, loop forever
  }
  // Show initial display buffer contents on the screen --
  // the library initializes this with an Adafruit splash screen.
  display.display();
  delay(2000); // Pause for 2 seconds
  // Clear the buffer
  display.clearDisplay();
  display.display();

}

//----------------------------------------------------------------------------------
// LOOP
//----------------------------------------------------------------------------------
void loop() {
  // Encoder  
  doEncoder();
  if (stuffChanged) {
    stuffChanged = false;
    Serial.println(currentPos);
    //doDisplayPos();
  }
  // Display
  if (state == 1){
    display.clearDisplay();
    display.drawBitmap(0, 0, background, 128, 64, WHITE);
    int prevPos = 0;
    int nextPos = 0;
    prevPos = currentPos - 1;
    if (prevPos < 0) {// previous item would be below first = make it the last
      prevPos = num_items - 1;
    } 
    nextPos = currentPos + 1;  // next item would be after last = make it the first
    if (nextPos >= num_items) {
      nextPos = 0;
    } 
    display.setTextSize(1);             // Normal 1:1 pixel scale
    display.setTextColor(SSD1306_WHITE);        // Draw white text
    display.drawBitmap(col_a, icon_toprow, menu_icons[prevPos], icon_width, icon_height, WHITE);
    display.setCursor(6, text_row);
    display.println(menu_items[prevPos]);
    display.drawBitmap(col_b, icon_toprow, menu_icons[currentPos], icon_width, icon_height, WHITE);
    display.setCursor(47, text_row);
    display.println(menu_items[currentPos]);
    display.drawBitmap(col_c, icon_toprow, menu_icons[nextPos], icon_width, icon_height, WHITE);
    display.setCursor(96, text_row);
    display.println(menu_items[nextPos]);
    display.display();
    delay(100);
  }
  else if (state == 2){
    display.clearDisplay();
    display.setTextSize(1);
    display.setTextColor(SSD1306_WHITE);
    display.setCursor(20, 20);
    display.println("Make coffee time");
    display.display();
    delay(100);
  }
    else if (state == 3){
    display.clearDisplay();
    display.setTextSize(1);
    display.setTextColor(SSD1306_WHITE);
    display.setCursor(20, 20);
    display.println("Set ALARM time");
    display.display();
    delay(100);
  }
}
//----------------------------------------------------------------------------------
// BASURA
//----------------------------------------------------------------------------------
