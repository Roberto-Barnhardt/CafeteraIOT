/*
Hecho:
  - Rotary encoder contando correctamente.
Por hacer:
  - MQTT...
  - OLED...
  - MENU ENTERO...
*/
//Probando1
//-------------------------------------------------------------------------------
//Librerías generales
//-------------------------------------------------------------------------------
#include <string>
#include <ArduinoJson.h>
// definimos macro para indicar función y línea de código en los mensajes
//#define DEBUG_STRING "["+String(__FUNCTION__)+"():"+String(__LINE__)+"] "
// documento JSON para envío mensaje.
StaticJsonDocument<64> alarm_json;
StaticJsonDocument<64> coffee_status_json;
StaticJsonDocument<64> coffee_s_json;
StaticJsonDocument<64> alarm_s_json;
StaticJsonDocument<64> water_level_json;
//StaticJsonDocument<256> mensaje;
//StaticJsonDocument<128> prueba_post;
//----------------------------------------------------------------------------------
// WiFi SETUP
//----------------------------------------------------------------------------------
//Librerías
#include <WiFi.h>
//Variables
String ssid = "MOVISTAR_3D01";
String password = "LC4hwy775866XGmZnZ7h";
WiFiClient wifi_client;
//Funciones
void conectar_wifi(){
  Serial.println("Conectando a " + ssid + " ...");
  WiFi.begin(ssid, password);
  while(WiFi.status()!=WL_CONNECTED){
    delay(1000);
    Serial.print(".");
  }
  Serial.println("Conectado a " + ssid + " !");  
}
// Functions

//----------------------------------------------------------------------------------
// MQTT SETUP
//----------------------------------------------------------------------------------
//Librerías
#include <PubSubClient.h>
//Variables
PubSubClient mqtt_client(wifi_client);
String alarm_s = "";
String alarm_h = "";
String coffee_s = "";
bool makingCoffee;
//MQTT
String mqtt_server = "192.168.1.47";
String id_placa = "";
//Topics
String topic_pub = "";
String topic_alarm_status = "cafeteraiot/alarm/status";
String topic_coffee_status = "cafeteraiot/coffee/status";
String topic_water_level = "cafeteraiot/water_level";
//Funciones
void conectar_mqtt(){
  while(!mqtt_client.connected()){
    Serial.println("Intentando conectar con broker MQTT...");
    //if (mqtt_client.connect(id_placa.c_str(), mqtt_username.c_str(), mqtt_password.c_str())){ //UMA
    if (mqtt_client.connect("Paquito")){ //Mio   id_placa.c_str()
      Serial.println("Conectado a broker: " + mqtt_server);
    }
    else{
      Serial.println("Error de conexión, código: " + mqtt_client.state());
      Serial.println("Intentando de nuevo en 5s...");
      delay(5000);
    }
  }
}
//Callback
void procesa_mensaje(char* topic, byte* payload, unsigned int length) { 
  String mensaje=String(std::string((char*) payload,length).c_str());
  Serial.println("Mensaje recibido ["+ String(topic) +"] "+ mensaje);
  // compruebo el topic
  if(String(topic)==topic_alarm_status) // == *topic al que estemos suscrito*
  {
    deserializeJson(alarm_json, mensaje);
    String alarm_status = alarm_json["status"];
    String alarm_time = alarm_json["time"];
    alarm_s = alarm_status;
    alarm_h = alarm_time;
  }
  else if(String(topic)==topic_coffee_status) // == *topic al que estemos suscrito*
  {
    deserializeJson(coffee_status_json, mensaje);
    String coffee_status = coffee_status_json["status"];
    coffee_s = coffee_status;
    if (coffee_s == "on"){
      makingCoffee = true;
    } else if(coffee_s == "off"){
      makingCoffee = false;
    }
  }
}
//----------------------------------------------------------------------------------
// DISPLAY SETUP
//----------------------------------------------------------------------------------
// Libraries
#include <Wire.h>
#include <Adafruit_GFX.h>
#include <Adafruit_SSD1306.h>

// Definitions
#define SCREEN_WIDTH 128 // OLED display width, in pixels
#define SCREEN_HEIGHT 64 // OLED display height, in pixels
#define OLED_RESET     -1 // Reset pin # (or -1 if sharing Arduino reset pin)
#define SCREEN_ADDRESS 0x3C ///< See datasheet for Address; 0x3D for 128x64, 0x3C for 128x32
Adafruit_SSD1306 display(SCREEN_WIDTH, SCREEN_HEIGHT, &Wire, OLED_RESET);

// Functions
//----------------------------------------------------------------------------------
// POT SWITCH
//----------------------------------------------------------------------------------
#define potSW 33

bool potInplace = false;
bool checkSW = false;
unsigned long last_potSW_interrupt;

void checkPot(){
  if (millis() - last_potSW_interrupt > 100) {
  last_potSW_interrupt = millis();
  checkSW = true;
  }
}

//----------------------------------------------------------------------------------
// TEMP SENSOR
//----------------------------------------------------------------------------------    
//Libraries
#include <OneWire.h>
#include <DS18B20.h>
//Definitions
#define ONE_WIRE_BUS 4
OneWire oneWire(ONE_WIRE_BUS);
DS18B20 sensor(&oneWire);
unsigned long last_temp_check = 0;
int temp = 0;
//Functions
//----------------------------------------------------------------------------------
// ULTRASONIC SENSOR
//----------------------------------------------------------------------------------    
//Libraries
#include <hcsr04.h>
//Definitions
#define TRIG_PIN 26
#define ECHO_PIN 27
HCSR04 hcsr04(TRIG_PIN, ECHO_PIN, 20, 4000);
unsigned long last_water_check = 0;
int water_level_percent = 0;
//Functions
void doWaterLevel(){
    int water_level_mm = hcsr04.distanceInMillimeters();
    water_level_percent = map(water_level_mm, 115, 25, 0, 100);
    water_level_json["level"] = water_level_percent;
    String water_level_str;
    serializeJson(water_level_json, water_level_str);
    mqtt_client.publish(topic_water_level.c_str(), water_level_str.c_str(), true);
    Serial.println("Water level: " + String(water_level_percent) + " %.");
}
//----------------------------------------------------------------------------------
// DISPLAY GEOMETRY
//----------------------------------------------------------------------------------
//BACKGROUND
const unsigned char PROGMEM background[]={
  0x00,0x00,0x00,0x00,0x00,0x00,0x00,0x00,0x00,0x00,0x00,0x00,0x00,0x00,0x00,0x00,
  0x00,0x00,0x00,0x00,0x7F,0x80,0x00,0x00,0x00,0x00,0x00,0x00,0x00,0x00,0x00,0x00,
  0x00,0x00,0x00,0x00,0x7F,0xBF,0xBF,0xBF,0xBF,0xB0,0x5F,0xCF,0xC0,0x00,0x00,0x00,
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  0x00,0x00,0x00,0x00,0x00,0x1F,0xFF,0xFF,0xFF,0xFF,0xF0,0x00,0x00,0x00,0x00,0x00,
};

//MENU ICONS
const int16_t col_a = 3;
const int16_t col_b = 48;
const int16_t col_c = 95;
const int16_t icon_height = 32;
const int16_t icon_width = 32;
const int16_t icon_toprow = 19;
const int16_t text_row = 54;
const unsigned char PROGMEM coffee_icon[] = {
  0x00,0x00,0x00,0x00,
  0x00,0x03,0x00,0x00,
  0x00,0x03,0x00,0x00,
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  0x00,0x7F,0xF0,0x00
};
const unsigned char PROGMEM clock_icon[] = {
  0x00,0x00,0x00,0x00,
  0x00,0x0F,0xF0,0x00,
  0x00,0x3F,0xFC,0x00,
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  0x00,0x00,0x00,0x00
};

const unsigned char PROGMEM exit_icon[] = {
  0x1F,0xFF,0xFF,0xFF,
  0x1F,0xFF,0xFF,0xFF,
  0x18,0x00,0x00,0x07,
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  0x1F,0xFF,0xFF,0xFF
};
//ARRAYS
const unsigned int num_items = 3;
const unsigned char* menu_icons[num_items]{
  coffee_icon,
  clock_icon,
  exit_icon,
};
char menu_items[num_items][20]={
  {"CAFE"},
  {"ALARM"},
  {"EXIT"},
};

//Dashboard
const unsigned char PROGMEM dashboard_bmp[]= {
  0x00,0x00,0x00,0x00,0x00,0x00,0x00,0x00,0x00,0x00,0x10,0x00,0x00,0x00,0x00,0x00,
  0x3E,0x00,0x00,0x00,0x00,0x00,0x00,0x00,0x00,0x00,0x10,0x00,0x00,0x00,0x00,0x00,
  0x3F,0x9F,0xC7,0xE6,0x13,0xF1,0xFC,0xFE,0x7E,0x3E,0x10,0x00,0x00,0x00,0x00,0x00,
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  0x00,0x00,0x00,0x00,0x00,0x00,0x00,0x00,0x00,0x00,0x00,0x00,0x00,0x00,0x00,0x00,
};

//Alarm screen
const unsigned char PROGMEM small_clock[] = {
  0x7C,
  0x82,
  0x92,
  0x9A,
  0x82,
  0x82,
  0x7C
};

//----------------------------------------------------------------------------------
// ENCODER SETUP
//----------------------------------------------------------------------------------
// Libraries
#include <ESP32Encoder.h> 

// Definitions
#define encA 16 
#define encB 17 
#define encSW 5
bool setting_alarm = 0;
long currentPos = 0;
long lastPos = 0;
bool stuffChanged = false;
ESP32Encoder encoder;

//State things, should be below but needed now.
enum state{
  dashboard,
  menu,
  makeCoffee,
  setAlarm
};

state currentState = dashboard;
//Alarm time
unsigned int time_pos = 0; //0-3 for 01:23
unsigned int t_0, t_1, t_2, t_3 = 0;

// Functions
void countNormally(){
  // Handle wrapping around from the start to the end
  if (currentPos < 0) {
    encoder.setCount((num_items - 1) * 2);
    currentPos = encoder.getCount() / 2;
    lastPos = currentPos;
    stuffChanged = true;
  }
  // Handle wrapping around from the end to the start
  else if (currentPos > num_items - 1) {
    encoder.setCount(0);
    currentPos = encoder.getCount() / 2;
    lastPos = currentPos;
    stuffChanged = true;
  } 
  // Normal increment/decrement
  else if (currentPos != lastPos) {
    lastPos = currentPos;
    stuffChanged = true;
  }
}
void doEncoder() {
  currentPos = encoder.getCount() / 2;
  switch(currentState){
    case menu:
    case makeCoffee:
      countNormally();
    break;  
    case setAlarm:
      switch(setting_alarm){
        case false:
          countNormally();
        break;
        case true:
          switch(time_pos){
            case 0:
              if (currentPos < 0) {
                  encoder.setCount(4); // Set to 2
              } else if (currentPos > 2) {
                  encoder.setCount(0);
              }
            break;
            case 1:
            if (t_0 == 2 && currentPos > 3) {
                encoder.setCount(t_0 == 2 ? 6 : 0); // Set to 3 if t_0 is 2
            } else if (currentPos < 0 || currentPos > 9) {
                encoder.setCount(0);
            }
            break;
            case 2:
            if (currentPos < 0) {
                encoder.setCount(10); // Set to 5
            } else if (currentPos > 5) {
                encoder.setCount(0);
            }
            break;
            case 3:
            if (currentPos <= 0 || currentPos >= 9) {
                encoder.setCount(0);
            }
            break;
          }
        break;
      }
    break;
    case dashboard:
      encoder.setCount(0);
      currentPos = encoder.getCount() / 2;
    break;
  }
}
//----------------------------------------------------------------------------------
// STATES
//----------------------------------------------------------------------------------
//Definitions
#define relayPin 14
//unsigned int state moved up as it was needed earlier.
bool update_coffee_s = 0;
bool update_alarm_s = 0;
bool do_set_alarm = 0;
unsigned long last_interrupt_time = 0;
//unsigned long interrupt_time;
unsigned long coffee_making_time = 0;
unsigned int coffee_heat_time = 60*40; //40 mins == real coffee machine timer
//Functions
void doStates(){
  //Serial.println("click");
  //static unsigned long last_interrupt_time = 0;
  
  if (millis() - last_interrupt_time > 200) {
    last_interrupt_time = millis();
    switch(currentState){ //MENU -----------------------------------------------
      case menu:
        switch(currentPos) {
          case 0:
          currentState = makeCoffee; //Make coffee
          break;
          case 1:
          currentState = setAlarm; //Set alarm
          break;
          case 2:
          currentState = dashboard; //Exit from menu
          break;
        }
      break;
      case makeCoffee: //MAKE COFFEE --------------------------------------------
        switch (currentPos){
          case 0:
            if (coffee_s == "off"){
              Serial.println("turn off thing");
              coffee_s = "on";
              makingCoffee = true;
              update_coffee_s = true;
            }
          break;
          case 1:
            if (coffee_s == "on"){
              Serial.println("turn off thing");
              coffee_s = "off";
              makingCoffee = false;
              update_coffee_s = true;
            }
          break;
          case 2:
          currentState = menu;
          break;
        }
      break;
      case setAlarm: //SET ALARM ------------------------------------------
        switch(setting_alarm){
          case false:
            switch (currentPos){
              case 0: //Set time
                setting_alarm = true;
              break;
              case 1: //turn alarm off
                if(alarm_s == "on"){
                  alarm_s = "off";
                  update_alarm_s = true;
                }
              break;
              case 2: //exit to menu
              currentState = menu;
              break;
            }
          break;
          case true:
            switch(time_pos){
              case -1://init
                time_pos++;
              break;
              case 0:
                t_0 = currentPos;
                encoder.setCount(0);
                time_pos++;
              break;
              case 1:
                t_1 = currentPos;
                encoder.setCount(0);
                time_pos++;
              break;
              case 2:
                t_2 = currentPos;
                encoder.setCount(0);
                time_pos++;
              break;
              case 3:
                t_3 = currentPos;
                encoder.setCount(0);
                time_pos++;
                do_set_alarm = true;
              break;
            }
          break;
        }
        
      break;
      case dashboard:
        currentState = menu;
      break;   
    } 
  } 
}

//----------------------------------------------------------------------------------
// SETUP
//----------------------------------------------------------------------------------
void setup() {
  // Serial----------------------------------------------
  Serial.begin(115200);

  //WiFi ----------------------------------
  conectar_wifi();

  //MQTT ---------------------------------------------------------
  id_placa = ESP.getEfuseMac();
  Serial.println("ID ESP32: " + id_placa);
  Serial.println("Topic PUB: " + topic_pub);
  mqtt_client.setServer(mqtt_server.c_str(), 1883);
  mqtt_client.setCallback(procesa_mensaje);
  //mqtt_client.setBufferSize(512);
  conectar_mqtt();
  mqtt_client.subscribe(topic_alarm_status.c_str());
  mqtt_client.subscribe(topic_coffee_status.c_str());

  // Encoder---------------------------------------------
  encoder.attachHalfQuad(encB, encA);
  encoder.setCount(0);  
  pinMode(encSW, INPUT_PULLUP);
  attachInterrupt(encSW, doStates, RISING);

  // Relay -------------------------------------------------
  pinMode(relayPin, OUTPUT);

  // Pot Switch ---------------------------------------------
  pinMode(potSW, INPUT_PULLUP);
  attachInterrupt(potSW, checkPot, RISING);
  checkPot();
  //Temp Sensors ---------------------------------------------
  sensor.begin();

  //Ultrasonic Sensor----------------------------------------------
  doWaterLevel();

  // Display---------------------------------------------------------
  if(!display.begin(SSD1306_SWITCHCAPVCC, SCREEN_ADDRESS)) {
    Serial.println(F("SSD1306 allocation failed"));
    for(;;); // Don't proceed, loop forever
  }
  // Show initial display buffer contents on the screen --
  // the library initializes this with an Adafruit splash screen.
  display.display();
  delay(2000); // Pause for 2 seconds
  // Clear the buffer
  display.clearDisplay();
  display.display();

}

//----------------------------------------------------------------------------------
// LOOP
//----------------------------------------------------------------------------------
void loop() {
  // Encoder
  doEncoder();
  // Pot switch
  if (checkSW){
    delay(50);
    potInplace = !digitalRead(potSW);
    checkSW = false;
  }
  // Temp sensors
  if (millis() - last_temp_check > 500){
    last_temp_check = millis();
    sensor.requestTemperatures();
    temp = sensor.getTempC();
  }
  // Ultrasonic sensor
  if (millis() - last_water_check > 10000){
    last_water_check = millis();
    doWaterLevel();
  }
  //Update coffee status
  if (update_coffee_s){
    update_coffee_s = false;
    coffee_s_json["status"] = coffee_s;
    String coffee_s_str;
    serializeJson(coffee_s_json, coffee_s_str);
    mqtt_client.publish(topic_coffee_status.c_str(), coffee_s_str.c_str(), true);
  }
  //Toggle coffee machine LOW = RELAY ON // HIGH = RELAY OFF
  if (makingCoffee){
    digitalWrite(relayPin, LOW);
  }else{
    digitalWrite(relayPin, HIGH);
  }
  
  //Set alarm time
  if(do_set_alarm){
    String set_alarm_time = String(t_0) + String(t_1) + ":" + String(t_2) + String(t_3);
    time_pos = 0;
    t_0, t_1, t_2, t_3 = 0;
    do_set_alarm = false;
    Serial.println("alarm set at: " + set_alarm_time);
    alarm_s_json["status"] = "on";
    alarm_s_json["time"] = set_alarm_time;
    String alarm_s_str;
    serializeJson(alarm_s_json, alarm_s_str);
    mqtt_client.publish(topic_alarm_status.c_str(), alarm_s_str.c_str(), true);
    setting_alarm = false;
  }
  //update alarm status
  if (update_alarm_s){
    update_alarm_s = false;
    alarm_s_json["status"] = alarm_s;
    alarm_s_json["time"] = "Off";
    String alarm_s_str;
    serializeJson(alarm_s_json, alarm_s_str);
    mqtt_client.publish(topic_alarm_status.c_str(), alarm_s_str.c_str(), true);
  }
  //encoder someting but cant remember
  if (stuffChanged) {
    stuffChanged = false;
    Serial.println(currentPos);
    //doDisplayPos();
  }
  // MQTT
  while (!mqtt_client.connected()){
    conectar_mqtt();
  }
  //Display updates
  switch(currentState){
    case dashboard:
      doDashboard();
    break;
    case menu:
      doMenu();
    break;
    case setAlarm:
      doSetAlarm();
    break;
    case makeCoffee:
      doMakeCoffee();
    break;
  }
  display.display();
  delay(50);
  //MQTT Loop
  mqtt_client.loop();
}
//----------------------------------------------------------------------------------
// DISPLAY FUNCTIONS
//----------------------------------------------------------------------------------

void doDashboard(){
    display.clearDisplay();
    display.drawBitmap(0, 0, dashboard_bmp, 128, 64, WHITE);
    display.setTextSize(1);
    display.setTextColor(SSD1306_WHITE);
    display.setCursor(95, 4);
    if (alarm_s == "off"){
      display.println("Off");
    }
    else if (alarm_s == "on"){
      display.println(alarm_h);
    }
    else{
      display.println("???");
    }
    //Pot data
    display.setCursor(45, 50);
    display.println("Pot: ");
    display.setCursor(73, 50);
    if(potInplace){
      display.println("OK");
    }
    else if(!potInplace){
      display.println("Missing");
    }
    //Temperature
    display.setCursor(45, 20);
    display.println("Temp: ");
    display.setCursor(75, 20);
    display.println(temp);
    display.setCursor(90, 20);
    display.println("C");
    //Water level
    display.setCursor(45, 35);
    display.println("Water: ");
    display.setCursor(82, 35);
    display.println(water_level_percent);
    display.setCursor(102, 35);
    display.println("%");
    

}

void doMenu(){
    display.clearDisplay();
    display.drawBitmap(0, 0, background, 128, 64, WHITE);
    int prevPos = 0;
    int nextPos = 0;
    prevPos = currentPos - 1;
    if (prevPos < 0) {// previous item would be below first = make it the last
      prevPos = num_items - 1;
    } 
    nextPos = currentPos + 1;  // next item would be after last = make it the first
    if (nextPos >= num_items) {
      nextPos = 0;
    } 
    display.setTextSize(1);             // Normal 1:1 pixel scale
    display.setTextColor(SSD1306_WHITE);        // Draw white text
    display.drawBitmap(col_a, icon_toprow, menu_icons[prevPos], icon_width, icon_height, WHITE);
    display.setCursor(6, text_row);
    display.println(menu_items[prevPos]);
    display.drawBitmap(col_b, icon_toprow, menu_icons[currentPos], icon_width, icon_height, WHITE);
    display.setCursor(47, text_row);
    display.println(menu_items[currentPos]);
    display.drawBitmap(col_c, icon_toprow, menu_icons[nextPos], icon_width, icon_height, WHITE);
    display.setCursor(96, text_row);
    display.println(menu_items[nextPos]);
}

void doSetAlarm(){
  display.clearDisplay();
  display.setTextSize(1);
  display.setTextColor(SSD1306_WHITE);
  //TITLE
  display.drawLine(0, 15, SCREEN_WIDTH, 15, SSD1306_WHITE);
  display.drawLine(83, 15, 83, 0, SSD1306_WHITE);
  display.setCursor(14, 4);
  display.println("SET ALARM");
  display.drawBitmap(87, 4, small_clock, 7, 7, WHITE);
  display.setCursor(95, 4);
  if (alarm_s == "off"){
    display.println("Off");
  }
  else if (alarm_s == "on"){
    display.println(alarm_h);
  }
  else{
    display.println("???");
  }
  //MENU
  display.setCursor(4, 53);
  display.println("Set");
  display.setCursor(44, 53);
  display.println("Off");
  display.setCursor(85, 53);
  display.println("Exit");
  //TIME
  switch(setting_alarm){
    case false:
      display.drawRect(40*currentPos, 48, 40, 16, SSD1306_WHITE);
      display.setTextSize(3);
      display.setCursor(25, 20); //First h pos.
      display.println("0");
      display.setCursor(42, 20); //Second h pos.
      display.println("0");
      display.setCursor(53, 20);
      display.println(":");
      display.setCursor(64, 20); //First min pos.
      display.println("0");
      display.setCursor(81, 20); //Second min pos.
      display.println("0");
    break;
    case true:
      switch(time_pos){
        case 0:
          display.drawLine(24, 42, 40, 42, SSD1306_WHITE);
          display.setTextSize(3);
          display.setCursor(25, 20); //First h pos.
          display.println(currentPos);
          display.setCursor(42, 20); //Second h pos.
          display.println("0");
          display.setCursor(53, 20);
          display.println(":");
          display.setCursor(64, 20); //First min pos.
          display.println("0");
          display.setCursor(81, 20); //Second min pos.
          display.println("0");
        break;
        case 1:    
          display.drawLine(38, 42, 54, 42, SSD1306_WHITE);
          display.setTextSize(3);
          display.setCursor(25, 20); //First h pos.
          display.println(t_0);
          display.setCursor(42, 20); //Second h pos.
          display.println(currentPos);
          display.setCursor(53, 20);
          display.println(":");
          display.setCursor(64, 20); //First min pos.
          display.println("0");
          display.setCursor(81, 20); //Second min pos.
          display.println("0");
        break;
        case 2:
          display.drawLine(58, 42, 74, 42, SSD1306_WHITE);
          display.setTextSize(3);
          display.setCursor(25, 20); //First h pos.
          display.println(t_0);
          display.setCursor(42, 20); //Second h pos.
          display.println(t_1);
          display.setCursor(53, 20);
          display.println(":");
          display.setCursor(64, 20); //First min pos.
          display.println(currentPos);
          display.setCursor(81, 20); //Second min pos.
          display.println("0");
        break;
        case 3:
          display.drawLine(74, 42, 90, 42, SSD1306_WHITE);
          display.setTextSize(3);
          display.setCursor(25, 20); //First h pos.
          display.println(t_0);
          display.setCursor(42, 20); //Second h pos.
          display.println(t_1);
          display.setCursor(53, 20);
          display.println(":");
          display.setCursor(64, 20); //First min pos.
          display.println(t_2);
          display.setCursor(81, 20); //Second min pos.
          display.println(currentPos);
        break;
      }
    break;
  }
}

void doMakeCoffee(){
  display.clearDisplay();
  display.setTextSize(1);
  display.setTextColor(SSD1306_WHITE);
  display.drawLine(0, 15, SCREEN_WIDTH, 15, SSD1306_WHITE);
  display.setCursor(4, 53);
  display.println("Start");
  display.setCursor(44, 53);
  display.println("Stop");
  display.setCursor(85, 53);
  display.println("Exit");
  display.drawRect(40*currentPos, 48, 40, 16, SSD1306_WHITE);
  display.setCursor(20, 20);
  display.println("Status: ");
  display.setCursor(64, 20);
  if (makingCoffee){
    display.println("ON");
  }else if(!makingCoffee){
    display.println("OFF");
  }
}
